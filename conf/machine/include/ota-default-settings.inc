## conf/machine/include/ota-default-settings.inc
```bitbake
IMAGE_CLASSES += "image_ota_part"
IMAGE_FSTYPES ?= "ota_sdcard ext4"
#IMAGE_FSTYPES_remove = "rpi_sdimg"
#IMAGE_CLASSES_remove = "sdcard_image-rpi"
```

## conf/machine/ota-raspberry.conf
```bitbake
#@TYPE: Machine
#@NAME: RaspberryPi 3 Development Board
#@DESCRIPTION: Machine configuration for the RaspberryPi 3

#U-BOOT enable and configuration, according to https://github.com/agherzan/meta-raspberrypi/blob/rocko/docs/extra-build-config.md#boot-to-u-boot

DEFAULTTUNE ?= "cortexa7thf-neon-vfpv4"

require conf/machine/include/tune-cortexa7.inc
include conf/machine/include/ota-default-settings.inc
include conf/machine/include/rpi-base.inc


#IMAGE GENERATION
SDCARD_ROOTFS ?= "${IMGDEPLOYDIR}/${IMAGE_NAME}.rootfs.ext4"
SDCARD_TOTAL_SIZE="1073741"


#TODO : switch case to choose the good underlying hardware
MACHINE = "raspberrypi3"
MACHINE_EXTRA_RRECOMMENDS += "\
    linux-firmware-bcm43430 \
    linux-firmware-bcm43455 \
    linux-firmware-bcm43430a1-hcd \
    linux-firmware-bcm4345c0-hcd \
"

SDIMG_KERNELIMAGE ?= "kernel7.img"
UBOOT_MACHINE = "rpi_3_32b_config"
SERIAL_CONSOLES ?= "115200;ttyS0"
VC4_CMA_SIZE ?= "cma-256"
```

## recipes-core/ota-utils/ota-utils-1.0/ota.its
```
/dts-v1/;
  
/ {
    description = "U-Boot fitImage for raspberrypi3_kernel";
    #address-cells = <1>;
  
    images {
        kernel@0 {
           description = "Linux Kernel";
            data = /incbin/("./uImage");
            type = "kernel";
            arch = "arm64";
            os = "linux";
            compression = "none";
            load = <0x80000>;
            entry = <0x80000>;
            hash@1 {
                algo = "sha1";
            };
        };
        fdt@0 {
            description = "Flattened Device Tree blob";
            data = /incbin/("./MACHINE.dtb");
            type = "flat_dt";
            arch = "arm64";
            compression = "none";
            hash@1 {
                algo = "sha1";
            };
        };
         kernel@1 {
           description = "Linux Kernel Recovery";
            data = /incbin/("./uImage");
            type = "kernel";
            arch = "arm64";
            os = "linux";
            compression = "none";
            load = <0x80000>;
            entry = <0x80000>;
            hash@1 {
                algo = "sha1";
            };
        };
            
     };
	ramdisk@0 {
		description = "update initramfs";
		data = /incbin/("./MACHINE-ramdisk");
		type = "ramdisk";
		arch = "arm64";
		os = "linux";
		compression = "gzip";
		load = <00000000>;
		entry = <00000000>;
		hash@1 {
			algo = "sha1";
		};
	};
    configurations {
        default = "conf@1";
        conf@1 {
            description = "Boot Linux kernel with FDT blob + rootfs";
            kernel = "kernel@0";
            fdt = "fdt@0";
            ramdisk = "ramdisk@0";
            hash@1 {
                algo = "sha1";
            };
        };
         conf@2 {
            description = "Boot Recovery Linux Kernel with initramfs";
            kernel = "kernel@0";
            fdt = "fdt@0";
            ramdisk = "ramdisk@0";
            hash@1 {
                algo = "sha1";
            };
        };
   };
};
```
